	AREA MYDATA, DATA, READONLY	
		
GPIOA_IDR  EQU  0X08+0x40010800
GPIOA_ODR  EQU  0X0C+0x40010800	
GPIOB_BASE EQU  0x40010C00
GPIOB_ODR  EQU  GPIOB_BASE+ 0X0C	
INTERVAL EQU 0x566004
;THE BASE ADDRESS OF RCC REGISTER			
RCC_BASE_ADDRESS_REG          EQU   0x40021000		
;THE REGISTER FOR ENABLE THE CLK FOR THE PORT
RCC_APB2ENR_ADDRESS_REG	      EQU   RCC_BASE_ADDRESS_REG + 0x18 


;PORTA REGISTERS
GPIO_PORTA_BASE_ADDRESS     EQU     0x40010800
GPIO_PORTA_CRL_ADDRESS_REG  EQU     GPIO_PORTA_BASE_ADDRESS+0x00
GPIO_PORTA_CRH_ADDRESS_REG  EQU     GPIO_PORTA_BASE_ADDRESS+0x04
GPIO_PORTA_ODR_ADDRESS_REG  EQU     GPIO_PORTA_BASE_ADDRESS+0x0C
GPIO_PORTA_IDR_ADDRESS_REG  EQU     GPIO_PORTA_BASE_ADDRESS+0x08




;PORTB REGISTERS
GPIO_PORTB_BASE_ADDRESS     EQU     0x40010C00
GPIO_PORTB_CRL_ADDRESS_REG  EQU     GPIO_PORTB_BASE_ADDRESS+0x00
GPIO_PORTB_CRH_ADDRESS_REG  EQU     GPIO_PORTB_BASE_ADDRESS+0x04
GPIO_PORTB_ODR_ADDRESS_REG  EQU     GPIO_PORTB_BASE_ADDRESS+0x0C
GPIO_PORTB_IDR_ADDRESS_REG  EQU     GPIO_PORTB_BASE_ADDRESS+0x08



;PORTC REGISTERS
GPIO_PORTC_BASE_ADDRESS     EQU      0x40011000
GPIO_PORTC_CRL_ADDRESS_REG  EQU     GPIO_PORTC_BASE_ADDRESS+0x00
GPIO_PORTC_CRH_ADDRESS_REG  EQU     GPIO_PORTC_BASE_ADDRESS+0x04
GPIO_PORTC_ODR_ADDRESS_REG  EQU     GPIO_PORTC_BASE_ADDRESS+0x0C
GPIO_PORTC_IDR_ADDRESS_REG  EQU     GPIO_PORTC_BASE_ADDRESS+0x08

;CONFIQURATIONS PREPROCESSING FOR PORTS
PORTA   EQU    0X04
PORTB   EQU    0X08
PORTC   EQU    0X10

;CONFIGURATION PREPROCESSING FOR PINS
PIN0    EQU    0X00
PIN1    EQU    0X01
PIN2    EQU    0X02
PIN3    EQU    0X03
PIN4    EQU    0X04
PIN5    EQU    0X05
PIN6    EQU    0X06
PIN7    EQU    0X07
	
	
PIN8     EQU    0X00
PIN9     EQU    0X01
PIN10    EQU    0X02
PIN11    EQU    0X03
PIN12    EQU    0X04
PIN13    EQU    0X05
PIN14    EQU    0X06
PIN15    EQU    0X07



PIN13_EANBLE EQU 13

INTERVAL1 EQU 0x566004		;just a number to perform the delay. this number takes roughly 1 second to decrement until it reaches 0


;OUTPUT OR INPUT CONFIGURATION
OUTPUT  EQU    0X01
INPUT   EQU    0X08


;PINWRITE 

HIGH   EQU    0X01
LOW    EQU    0X00
	
	
	
	
RED  	EQU  	0xF800
BLACK   EQU     0X0000
BLUE 	EQU  	0x001F
YELLOW	EQU  	0xFFE0




	AREA MYDATA1, DATA, READWRITE	
		
WHICH_LEVEL DCW  0X01

myShip_X DCW  0X8C
myShip_Y DCW  0XBE



;LEVEL1_SHIPS


SHIP2_1X  DCW  0X2E
SHIP2_1Y  DCW  0X68

SHIP2_2X  DCW  0X62
SHIP2_2Y  DCW  0X68

SHIP2_3X  DCW  0X96
SHIP2_3Y  DCW  0X68


SHIP2_4X  DCW  0XCA
SHIP2_4Y  DCW  0X68

SHIP2_5X  DCW  0XFE
SHIP2_5Y  DCW  0X68



SHIP1_1X  DCW  0X14
SHIP1_1Y  DCW  0X31

SHIP1_2X  DCW  0X48
SHIP1_2Y  DCW  0X31

SHIP1_3X  DCW  0X7D
SHIP1_3Y  DCW  0X31

SHIP1_4X  DCW  0XB0
SHIP1_4Y  DCW  0X31

SHIP1_5X  DCW  0XE3
SHIP1_5Y  DCW  0X31

SHIP1_6X  DCW  0X117
SHIP1_6Y  DCW  0X31


 
WHICH_SHIP  DCB  0X00

STILL_LIVE  DCB  0X0B



	
	IMPORT ship
	IMPORT LEVEL_1
	IMPORT Space_SEL
	IMPORT Break	


	EXPORT __main

	AREA	MYCODE, CODE, READONLY
	ENTRY

	IMPORT LCD_COMMAND_WRITE
	IMPORT LCD_DATA_WRITE
	IMPORT LCD_INIT
	IMPORT ADDRESS_SET
	IMPORT DRAWPIXEL
	IMPORT DRAW_RECTANGLE_FILLED
	IMPORT DRAW_triangle 
	IMPORT SETUP
	IMPORT GPIO_PORTA_CONGIGURATION
	IMPORT GPIO_PORTA_READ_PIN
	IMPORT Draw_Break_SEL
	IMPORT Draw_SPACE_SEL
	

	
__main FUNCTION
		
	;X1 = [] r0
	;Y1 = [] r1
	;X2 = [] r3
	;Y2 = [] r4
	;COLOR = [] r10
	
		BL SETUP
		BL INITIALIZE_VARIABLES
		;THE LEVEL
		LDR R3, =WHICH_LEVEL
		MOV R2, #0X01
		STR R2, [R3]
		
		MOV R0,#0
		MOV R1,#320
		MOV R3,#0
		MOV R4,#240
		
		MOV R10,#0xfe01
		
		BL DRAW_RECTANGLE_FILLED_fast
		
		BL Draw_SPACE_SEL
		
		MOV R1, #PIN0      ;left
		MOV R2, #INPUT
		BL GPIO_PORTA_CONGIGURATION

		MOV R1, #PIN1     ;RIGHT
		MOV R2, #INPUT
		BL GPIO_PORTA_CONGIGURATION

		MOV R1, #PIN2     ;FIRE
		MOV R2, #INPUT
		BL GPIO_PORTA_CONGIGURATION
		
CHOOSE_GAMEE	
	  MOV R11, #PIN1             ;PUT IN R11 PIN5 TO CHECK THE RIGHT BUTTON
	  BL GPIO_PORTA_READ_PIN     ;CHECK IF THE RIGHT BUTTON PRESSED
      CMP R12, #LOW              ;IF PRESSED BRANC TO MOVE RIGHT
	  BEQ Draw_SPACE_SEL         ;IF NOT PRESSED COMPLETE THE CODE
	
	  
	  MOV R11, #PIN0             ;PUT IN R11 PIN1 TO CHECK THE LEFT BUTTON
	  BL GPIO_PORTA_READ_PIN      ;CHECK IF THE LEFT BUTTON PRESSED
      CMP R12, #LOW	          ;IF PRESSED BRANC TO MOVE LEFT
	  BEQ Draw_Break_SEL             ;IF NOT PRESSED COMPLETE THE CODE
	  
	  MOV R11, #PIN2            ;PUT IN R11 PIN5 TO CHECK THE FIRE BUTTON
	  BL GPIO_PORTA_READ_PIN     ;CHECK IF THE RIGHT BUTTON PRESSED
      CMP R12, #LOW             ;IF PRESSED BRANC TO MOVE RIGHT
	  BEQ  Make_ur_choice               ;IF NOT PRESSED COMPLETE THE CODE
	B CHOOSE_GAMEE

Make_ur_choice
	mov R12,#1
	CMP R0,#0	
  ; BNE                 BRANCH ON THE OTHER GAME __BREAKOUT TODO AHMED HESHAM
		
		;@@@@@@@@@@@@@@@@@@@@@@@@@@@@@@@@@@@@@@@@@@@@@@@@@@@@@@@@@@@@@@@@@@@@@@@@@@@@@@@@@@@@@@@


MOOT
	    BL INITIALIZE_VARIABLES
		
		MOV R0,#0
		MOV R1,#320
		MOV R3,#0
		MOV R4,#240
		LDR R10,=RED
		
		BL DRAW_RECTANGLE_FILLED_fast
		
		MOV R0,#0
		MOV R1,#320
		MOV R3,#0
		MOV R4,#240
		
		LDR R10,=BLACK
		
		BL DRAW_RECTANGLE_FILLED_fast
		
		
	
		; DRAWING ABOVE LINE OF ENEMIES
		MOV R0, #20	
		MOV R1, #51
		MOV R3, #15
		MOV R4, #50
		
		MOV R8,#6
DRAW
		BL Draw_ship_enemy_1
		
		ADD R0,R0,#52
		ADD R1,R1,#52
		
		SUB R8,#1
		
		
		CMP R8,#0
		
		BNE DRAW
		
 
		;;DRAWING LOWER LINE OF ENEMIES
		MOV R0, #46
		MOV R1, #77
		MOV R3, #64
		MOV R4, #98
		
		MOV R8,#5
		
		
		
		
DRAW_LOWER
		BL Draw_ship_enemy_1
		
		ADD R0,R0,#52
		ADD R1,R1,#52
		
		SUB R8,#1
		
		
		CMP R8,#0
		
		BNE DRAW_LOWER
		
		
;DRAWING OUR SHIP
		LDR  R0, =myShip_X    ; LOAD THE ADDRESS OF X IN R0
		LDRH R0,[R0]		 ; GET THE VALUE AND PUT IN R0
		ADD  R1,R0,#0X2C      ; PUT IN R1 THE VALUE OF X2
		LDR  R3, =myShip_Y    ; LOAD THE ADDRESS OF Y IN R3
		LDRH R3,[R3]         ; GET THE VALUE AND PUT IN R3
		ADD  R4,R3,#0X32      ; PUT IN R4 THE VALUE OF R4
		
	
		BL Draw_ship_1
		
		
		PUSH {R0-R4}
		
	       LDR   R5, =0X10101
		   LDR   R0, =WHICH_LEVEL
	       LDRB  R1, [R0]
		   CMP   R1, #0X01
		   BEQ    LEVEL1_1_1
		   
		   LDR  R5, =0X4fff
LEVEL1_1_1		   
		   
		POP {R0-R4}
		
		
WHILE1


		
		
;UPDATING THE VALUE OF THE VALUES OF THE REGISTERS TO THE COORDINATES OF THE SHIP

	   	LDR R0, =myShip_X    ; LOAD THE ADDRESS OF X IN R0
		LDRH R0,[R0]		 ; GET THE VALUE AND PUT IN R0
		ADD R1,R0,#0X2C      ; PUT IN R1 THE VALUE OF X2
		LDR R3, =myShip_Y    ; LOAD THE ADDRESS OF Y IN R3
		LDRH R3,[R3]         ; GET THE VALUE AND PUT IN R3
		ADD R4,R3,#0X32      ; PUT IN R4 THE VALUE OF R4
		
		
		CMP  R0, #0
		BEQ  ENDGAME
		
		BL  CHECK_WINNING
		CMP R12, #0
		BEQ ENDGAME_WIN
		
		
;DONE UPDATING R0,R1,R3, AND R4
	   
	   
	   
;CHEK AND MOVE
	  MOV R11, #PIN1             ;PUT IN R11 PIN5 TO CHECK THE RIGHT BUTTON
	  BL GPIO_PORTA_READ_PIN     ;CHECK IF THE RIGHT BUTTON PRESSED
      CMP R12, #LOW             ;IF PRESSED BRANC TO MOVE RIGHT
	  BEQ MOVE_RIGHT             ;IF NOT PRESSED COMPLETE THE CODE
	  
      MOV R11, #PIN0              ;PUT IN R11 PIN1 TO CHECK THE LEFT BUTTON
	  BL GPIO_PORTA_READ_PIN      ;CHECK IF THE LEFT BUTTON PRESSED
      CMP R12, #LOW	          ;IF PRESSED BRANC TO MOVE LEFT
	  BEQ MOVE_LEFT               ;IF NOT PRESSED COMPLETE THE CODE
;DONE CHECK AND MOVE	

	  B SKIPPED
	  LTORG
SKIPPED


;CHECK THE FIRE BUTTON
	  MOV R11, #PIN2             ;PUT IN R11 PIN5 TO CHECK THE SHOOT BUTTON
	  BL GPIO_PORTA_READ_PIN     ;CHECK IF THE RIGHT BUTTON PRESSED
      CMP R12, #LOW             ;IF PRESSED BRANC TO MOVE RIGHT
	  BEQ FIRE
;DONE CHECKING THE FIRE BUTTON

	 
	 SUB R5, #1
	 CMP R5,#0
	 BEQ DRAW_ROCKET_HIGH
	 
	 
	 B WHILE1
	 
	 

ENDGAME
	   
	   

	 B  MOOT


ENDGAME_WIN
	
	MOV R0, #0
	MOV R1, #320
	
	MOV R3, #0
	MOV R4, #240
	
	MOV R10, #YELLOW
	BL DRAW_RECTANGLE_FILLED_fast


	LDR   R0, =WHICH_LEVEL
	LDRB  R1, [R0]
	ADD   R1,R1,#1
	STRB  R1, [R0]

	B ENDEND
	
	
ENDEND


	   LDR   R0, =WHICH_LEVEL
	   LDRB  R1, [R0]
      
	   CMP   R1, #0X02
	   BEQ   ENDGAME
	   
YOU_ARE_DONE
      
	   B YOU_ARE_DONE
	ENDFUNC
	

	
CHECK_WINNING  FUNCTION
	PUSH {R0-R11, LR}
	
	
	MOV R12, #HIGH
	LDR R0, =STILL_LIVE
	LDRB R0, [R0]
	
	CMP R0, #0
	BNE NONONO
	
	MOV R12, #LOW
	
NONONO	
	POP  {R0-R11, PC}
	ENDFUNC


	
	;@@@@@@@@@@@@@@@@@@@@@@@@@@@@@@@@@@@@@@@@@@@@@@@@@@@@@@@@@@@@@@@222Function definitions@@@@@@@@@@@@@@@@@@@@@@@@@@@@@@@@@@@@@@@@@@@@@@@@@@@@22



MOVE_LEFT

	PUSH {R7,LR}
	
	CMP R0,#10
	BEQ LOOP_L

	MOV R10,#0X0000
	BL DRAW_RECTANGLE_FILLED_fast
	
    SUB R0,R0,#1
	SUB R1,R1,#1
	
	BL ADDRESS_SET

	BL Draw_ship_1
	
	
	
;STORE BACK THE VALUES NEW COORDINATES OF THE SHIP
	
	
	;UPDATING THE X COORDINATES
		LDR R7, =myShip_X
		STRH R0,[R7]
		
	
LOOP_L
	;THERE WAS A THING THAT AFTER DOING THIS FUNCTION IN RETURNS BACK TO THE LINE BEFORE THIS CALL
	;WHICH IS THE COMPARE NOT READING THE PUSH BUTTON
	;SO WE WRITE HERE IN R12 0 SO THE RESULT OF THE COMRAE DOESNT MATHC AND DOESNT CALL THE LOOP AGAIN

	MOV R12,#1
  
	POP {R7,PC}

DRAW_ROCKET_HIGH  FUNCTION
	
	PUSH {R0-R4, LR}
    
	BL DRAW_ROCKET
	
    LDR   R5, =0X10101
    LDR   R0, =WHICH_LEVEL
	LDRB  R1, [R0]
    CMP   R1, #0X01
    BEQ   LEVEL2_1_1
		   
    LDR  R5, =0X4fff
	
LEVEL2_1_1		   



	POP{R0-R4, PC}
	ENDFUNC



;DRAWING THE 
MOVE_RIGHT	

   	PUSH {R7,LR}
	
	CMP R1,#310     ;COMPARE IF IT REACHED THE MAXIMUM RIGHT
	BEQ LOOP_R      ; GO TO EDIT THE VALUE OF R12 ONLY

	MOV R10,#0X0000
	BL DRAW_RECTANGLE_FILLED_fast
	
    ADD R0,R0,#1
	ADD R1,R1,#1
	
	

	BL Draw_ship_1
	
	
;STORE BACK THE VALUES NEW COORDINATES OF THE SHIP
	
	;UPDATING THE X COORDINATES
		LDR R7, =myShip_X
		STRH R0,[R7]

	
	
LOOP_R
	;THERE WAS A THING THAT AFTER DOING THIS FUNCTION IN RETURNS BACK TO THE LINE BEFORE THIS CALL
	;WHICH IS THE COMPARE NOT READING THE PUSH BUTTON
	;SO WE WRITE HERE IN R12 0 SO THE RESULT OF THE COMRAE DOESNT MATHC AND DOESNT CALL THE LOOP AGAIN
	MOV R12,#1    
    
	POP {R7,PC}	


DRAW_ROCKET  FUNCTION
	
	PUSH {R0-R12, LR}
	
	BL DRAW_ROCKET_SHOOT
	
	
	POP  {R0-R12, PC}
	ENDFUNC
		

;DESCRIBTION:
;FIRING FROM OUR SHIP
FIRE  FUNCTION 
	
	PUSH {R0-R11, LR}

	
;2-CALL  GET_THE_SHOOT_POSTION

	BL DRAW_SHOOT

	
	MOV R12, #1
	
	POP {R0-R11, PC}
	ENDFUNC




	  B SKIPPED1
	  LTORG
SKIPPED1
;;;;;;;;;;;;;;;;;;;;;;;;;;;;;;;;;
	
Draw_ship_1
	PUSH {R0-R12, LR}
     
	
	BL ADDRESS_SET
 
    LDR R5,=ship
	MOV R7,#2200

	MOV R2, #0x2C
	BL LCD_COMMAND_WRITE

IMAGE_LOOP

	LDR R6, [R5], #2


	MOV R2, R6
	LSR R2, #8
	BL LCD_DATA_WRITE
	MOV R2, R6
	BL LCD_DATA_WRITE

	SUBS R7, R7, #1
	CMP R7, #0
	BNE IMAGE_LOOP


	POP {R0-R12, PC}


Draw_ship_enemy_1
	PUSH {R0-R12, LR}
     

	BL ADDRESS_SET
 
    LDR R5,=LEVEL_1
	MOV R7,#1088

	MOV R2, #0x2C
	BL LCD_COMMAND_WRITE

IMAGE_LOOP1

	LDR R6, [R5], #2


	MOV R2, R6
	LSR R2, #8
	BL LCD_DATA_WRITE
	MOV R2, R6
	BL LCD_DATA_WRITE

	SUBS R7, R7, #1
	CMP R7, #0
	BNE IMAGE_LOOP1


	POP {R0-R12, PC}

Draw_Back_ground
	PUSH {R0-R12, LR}

	BL ADDRESS_SET
 
    LDR R5,=RED
	LDR R7,=100000

	MOV R2, #0x2C
	BL LCD_COMMAND_WRITE

IMAGE_LOOP6


	MOV R2, R5
	LSR R2, #8
	BL LCD_DATA_WRITE
	MOV R2, R5
	BL LCD_DATA_WRITE

	SUBS R7, R7, #1
	CMP R7, #0
	BNE IMAGE_LOOP6


	POP {R0-R12, PC}





	  B SKIPPED2
	  LTORG
SKIPPED2



		
DRAW_RECTANGLE_FILLED_fast

		PUSH {R0-R12, LR}
		
	;X1 = [] r0                               X1=R0
	;Y1 = [] r1                               X2=R1
	;X2 = [] r3     -------------->>>>        Y1=R3
	;Y2 = [] r4                               Y2=R4
		
		;PERFORMING REORDERING
		;MOV R5,R1
		;MOV R1,R3      ; AS I USE THIS FUNCTION IN MOVE SHIP FUNCTION I DONT NEED THE REORDERING BECAUSE I USE ADRESS SET SUNCTION IN MOVE SHIP
		;MOV R3,R5        
			

		BL ADDRESS_SET
		
		MOV R2,#0X2C
		BL LCD_COMMAND_WRITE
		; GET THE AREA OF THE RECTANGEL
		SUB R6,R1,R0  ;R6=R1-R0
		SUB R7,R4,R3  ;R7=R4-R3
		ADD R7,#5
		MUL R6,R6,R7  ;R6=R6*R7
		
			
RECT_LOOP

	MOV R2, R10
	LSR R2, #8
	BL LCD_DATA_WRITE
	MOV R2, R10
	BL LCD_DATA_WRITE
	SUB R6,R6,#1
	CMP R6,#0
	BGT RECT_LOOP
		
		
		
	POP {R0-R12, PC}	
		
delay_10_milli_second
	;this function just delays for 10 millisecondS
	PUSH {R8, LR}
	LDR r8, =INTERVAL
delay_loop3
	SUBS r8, #100
	CMP r8, #0
	BGE delay_loop3

	POP {R8, PC}
	
	
	
	  B SKIPPED3
	  LTORG
SKIPPED3


	;DESCRIPTION:
;THIS FUNCTION IS USED TO DRAW THE FIRST RECTANGLE == FIRST FRAME OF THE SHOOT
DRAW_SHOOT   FUNCTION 
	
	
	;LOGICAL SEQUENCE:
;1-TAKE THE VARIABLES FOR THE MEMORY
;2-INCREMENT THE LENGTH BY 3
;3-UPDATE THE VALUES R0,R1,R3,R4
;4-DRAW THE RECTANGLE 
;5-STORE THE VALUE BACK TO THE MEMORY

	PUSH {R0-R12, LR}

	LDR  R5, =myShip_X  		  ; LOAD THE ADDRESS OF X IN R5
	LDRH R5,[R5]		     	  ; GET THE VALUE AND PUT IN R5
	
	LDR  R6, =myShip_Y         ; LOAD THE ADDRESS OF Y IN R6
	LDRH R6,[R6]                  ; GET THE VALUE AND PUT IN R6
		
;SET THE VALUES OF R0, R1, R3 AND R4 FOR THE RECTANGLE SHOOT
;PUT THE CORRECT VALUES IN R0, R1, R3, R4

	
	ADD R0, R5, #22
	
	ADD R1, R5, #26
	
	SUB R3, R6, #22
	
	SUB R4, R6, #2
	
	MOV R10,#RED


	BL DRAW_RECTANGLE_FILLED_fast   ; BRANCH FOR DRAW RECTANGLE TO DRAW THE SHOOT

	BL DRAW_SHOOT_AFTER
	
	POP {R0-R12, PC}
	ENDFUNC





	  B SKIPPED4
	  LTORG
SKIPPED4





	;DESCRIPTION:  
;DRAWING THE LOOP OF THE SHOOT
;IN THIS FUNCTION WE EDIT THE VALUES OF R3, R4, AND R10
; WE DONT NEED TO PUSH ANY REGISTERS AS WE WANT TO UPDATE THERE VALUES 

DRAW_SHOOT_AFTER   FUNCTION 

	;LOGICAL SEQUENCE:
	
	
;THE START OF THE LOOP

;1- DRAW RECTANGLE BLACK WITH THE SAME COORDINATES IN THE SAME POSTION OF THE R0,R1,R3,R4
;2- DECREMENT THE THE VALUES IN THE REGISTERS  BECAUSE WE ARE MOVING UP SO DECREMENTA
;3- DRAW RED RECTANGLE ON THE NEW COORDINATES 
;NOTE AFTER THIS INCREAMENT AND DRAW YOU NEED TO BRANCH FOR THE CHEKING LOOP FUNCTION
;THE END OF THE LOOP

	PUSH {LR}
	
		BL  CHECK_X_COLLOSION

	
DRAW_ROCKET_LOOP  

;STEP_1
		MOV R10, #BLACK
		BL  DRAW_RECTANGLE_FILLED_fast
;STEP_2	
		SUB R3, R3, #4
		SUB R4, R4, #4
;STEP_3
		MOV R10, #RED
		BL  DRAW_RECTANGLE_FILLED_fast
		
		BL CHECK_Y_COLLOSION

		
		CMP R3, #0
		BNE DRAW_ROCKET_LOOP
		
		MOV R10, #BLACK
		BL  DRAW_RECTANGLE_FILLED_fast
	
	POP {PC}
	ENDFUNC

	;DESCRIPTION: 
;THIS FUNCTION CHEKS THE COLLOSION OF BETWEEN THE FIRE AND THE SHIP
;YOU CAN USE ANY REG FROM R5 TO R12
;5,6,7,8,9,10,11,12

CHECK_X_COLLOSION   FUNCTION
	PUSH {R0-R9, LR} 
;LOGIC:
;1- CHECK WHICH TARGETED 
;2- SAVE IT
;3- COMPARE UTIL THEY COLLPASE

;LOOP ON CHEKING THE TARGETED SHIP
	LDR  R5, =SHIP2_1X
	LDR  R7, =SHIP2_1Y

	LDR  R11, =0X40000000
	LDR  R12, =0X40000000
	
	MOV R10, #11
	
	

LOOP_FOR_ALL_SHIPS
		
	LDRH R6, [R5], #4 ;LOADING THE X OF THE SHIP AND MOVING THE R5 TO LOCATE THE NEXT SHIP
		
	LDRH R8, [R7], #4 ;LOADING THE Y OF THE SHIP AND MOVING THE R7 TO LOCATE THE NET SHIP
	
	ADD R9, R6, #0X20
	
	CMP R0, R6
	BLT NONE1
  
COMPARE2

	 CMP R0, R9
	 BGT NONE1
	 SUB R5, #4
	 SUB R7, #4
	 
	 MOV R12, R5
	 MOV R11, R7
	 	
NONE1
	SUB R10, #1
	CMP R10, #0
	BGE LOOP_FOR_ALL_SHIPS



	POP {R0-R9, PC} 
	ENDFUNC



	  B SKIPPED5
	  LTORG
SKIPPED5




;DESCRIPTION:
;THIS FUNCTION WAITS UNTIL THE Y OF THE SHOOT EQUALS THE Y OF THE SHIP
CHECK_Y_COLLOSION   FUNCTION
	PUSH {R0-R12, LR}
	
	MOV R5, R11
	MOV R6, R12
	
	LDRH R11, [R5]
	LDRH R12, [R6]
	
	CMP R12, #0
	BEQ DO_NONE
	
	CMP R3, R11
	BGT DO_NONE  
	
	MOV R0, R12
	ADD R1, R12, #38 
	
	SUB R3, R11, #37 
	MOV R4, R11
	
	MOV R10, #BLACK
	BL DRAW_RECTANGLE_FILLED_fast
	
	LDR  R11, =STILL_LIVE
	LDR  R10, [R11]
	SUB  R10, #1
	STRB R10, [R11]
	
	MOV  R11, #0
	STRH R11, [R5]
	STRH R11, [R6]

DO_NONE

	POP {R0-R12, PC}
	ENDFUNC





DRAW_ROCKET_SHOOT FUNCTION
;LOGIC OF THE GAME
;1-GET THE WHICH
;2-GET THE CORESSPONDING SHIP
;3-DRAW FIRST
;4-DRAW AFTER
;5-UPDATE WHICH_SHIP

	PUSH {R0-R12, LR}
;STEP_1	
    LDR  R5, =WHICH_SHIP
	LDRB R8, [R5]
	
	
;STEP_2	
	LDR   R6, =SHIP2_1X
	ADD   R6, R6, R8
	LDRH  R6, [R6]

	LDR   R7, =SHIP2_1Y
	ADD   R7,  R7, R8
	LDRH  R7, [R7]
	
;STEP_3
    BL DRAW_ROCKET_FIRST

;STEP_5
    
	CMP  R8, #36
	BLT NONO
		
	
	ADD   R8, R8, #8
	SUB   R8, R8, #44
	STRB  R8, [R5]
	B MOMO
	
NONO
	ADD R8, R8, #8
	STRB R8, [R5]
	
MOMO
		
	POP  {R0-R12, PC}
	ENDFUNC
	
	


DRAW_ROCKET_FIRST   FUNCTION

	PUSH {LR}
	
	;SET THE VALUES OF R0, R1, R3 AND R4 FOR THE RECTANGLE SHOOT
;PUT THE CORRECT VALUES IN R0, R1, R3, R4

	CMP R6, #0
	BEQ DODO_NONE
	
	ADD R0, R6, #16
	
	ADD R1, R6, #20
	
	ADD R3, R7, #2
	
	ADD R4, R7, #22
	
	MOV R10,#BLUE

	BL DRAW_RECTANGLE_FILLED_fast   ; BRANCH FOR DRAW RECTANGLE TO DRAW THE SHOOT
	BL DRAW_ROCKET_AFTER


DODO_NONE	

	POP {PC}
	ENDFUNC
	


DRAW_ROCKET_AFTER  FUNCTION
	
	PUSH {LR}
	
DRAW_ROCKET_LOOP1  

;STEP_1
		MOV R10, #BLACK
		BL  DRAW_RECTANGLE_FILLED_fast
;STEP_2	
		ADD R3, R3, #1
		ADD R4, R4, #1
;STEP_3
		MOV R10, #BLUE
		BL  DRAW_RECTANGLE_FILLED_fast
		
		;CHECKING Y COLLISION
		BL CHECK_Y_COLLOSION_ROCKET
		
		CMP R4, #240
		BLT DRAW_ROCKET_LOOP1
		
		MOV R10, #BLACK
		BL  DRAW_RECTANGLE_FILLED_fast

	POP  {PC}
	ENDFUNC



CHECK_Y_COLLOSION_ROCKET   FUNCTION
    PUSH {R0-R12, LR}
	
	CMP R4,#200
	BLT DO_NONE22
	
	BL CHECK_X_COLLOSION_ROCKET
	
	

DO_NONE22
	
	POP {R0-R12, PC}
	ENDFUNC




CHECK_X_COLLOSION_ROCKET   FUNCTION
	PUSH {R0-R12, LR}
	
	LDR   R5, =myShip_X
	LDRH  R8, [R5]
	
	LDR   R6, =myShip_Y
	LDRH  R9, [R6]
	
	
	ADD R7, R8, #0X31
	
	CMP R0, R8
	BLT NONE11
  
COMPARE22

	 CMP R0, R7
	 BGT NONE11
	 
	 
	 MOV  R10, #0
	 STRH R10, [R5]
	 STRH R10, [R6]
	 
	 
	 
	 	
NONE11
		
	POP {R0-R12, PC}
	ENDFUNC
	
	



INITIALIZE_VARIABLES	FUNCTION
	PUSH{R0-R1,LR}
	;THIS FUNCTION JUST INITIALIZES ANY VARIABLE IN THE DATASECTION TO ITS INITIAL VALUES
	;ALTHOUGH WE SPECIFIED SOME VALUES IN THE DATA AREA, BUT THEIR VALUES MIGHT BE ALTERED DURING BOOT TIME.
	;SO WE NEED TO IMPLEMENT THIS FUNCTION THAT REINITIALIZES ALL VARIABLES
		
;INIZALIZATON MYSHIP
	LDR R0, =myShip_X
	MOV R1,#0X008C
	STR R1,[R0]
		
	LDR R0, =myShip_Y
	MOV R1,#0X00BE
	STR R1,[R0]
	

;INIALIZATION THE SHIP POSTIONS
;SECOND COLOUM
	LDR R0, =SHIP2_1X
	MOV R1, #0X2E
	STR R1, [R0]
	
	LDR R0, =SHIP2_1Y
	MOV R1, #0X68
	STR R1, [R0]
	
	
	LDR R0, =SHIP2_2X
	MOV R1, #0X62
	STR R1, [R0]
	
	LDR R0, =SHIP2_2Y
	MOV R1, #0X68
	STR R1, [R0]
	
	LDR R0, =SHIP2_3X
	MOV R1, #0X96
	STR R1, [R0]
	
	LDR R0, =SHIP2_3Y
	MOV R1, #0X68
	STR R1, [R0]
	
	
	LDR R0, =SHIP2_4X
	MOV R1, #0XCA
	STR R1, [R0]
	
	LDR R0, =SHIP2_4Y
	MOV R1, #0X68
	STR R1, [R0]
	
	
	LDR R0, =SHIP2_5X
	MOV R1, #0XFE
	STR R1, [R0]
	
	LDR R0, =SHIP2_5Y
	MOV R1, #0X68
	STR R1, [R0]
	
;FIRST COLOUM

	LDR R0, =SHIP1_1X
	MOV R1, #0X14
	STR R1, [R0]
	
	LDR R0, =SHIP1_1Y
	MOV R1, #0X31
	STR R1, [R0]
	
	
	LDR R0, =SHIP1_2X
	MOV R1, #0X48
	STR R1, [R0]
	
	LDR R0, =SHIP1_2Y
	MOV R1, #0X31
	STR R1, [R0]
	
	
	LDR R0, =SHIP1_3X
	MOV R1, #0X7D
	STR R1, [R0]
	
	LDR R0, =SHIP1_3Y
	MOV R1, #0X31
	STR R1, [R0]


	LDR R0, =SHIP1_4X
	MOV R1, #0XB0
	STR R1, [R0]
	
	LDR R0, =SHIP1_4Y
	MOV R1, #0X31
	STR R1, [R0]


	LDR R0, =SHIP1_5X
	MOV R1, #0XE3
	STR R1, [R0]
	
	LDR R0, =SHIP1_5Y
	MOV R1, #0X31
	STR R1, [R0]


	LDR R0, =SHIP1_6X
	MOV R1, #0X117
	STR R1, [R0]
	
	LDR R0, =SHIP1_6Y
	MOV R1, #0X31
	STR R1, [R0]

	
;NO OF SHIPS
	LDR R0, =STILL_LIVE
	MOV R1, #0X0B
	STRB R1, [R0]



	POP{R0-R1,PC}
	ENDFUNC






	END